/*
 * ----------------------------------------------------------------------------
 * AMIGO HOSPITAL ROBOT - NodeMCU (ESP8266) RFID Reader & Supabase Integration
 * ----------------------------------------------------------------------------
 *
 * Hardware Wiring (NodeMCU ESP8266 <-> MFRC522 RFID Reader):
 *   - MFRC522 SDA (SS)  -> NodeMCU Pin D8 (GPIO15)
 *   - MFRC522 SCK       -> NodeMCU Pin D5 (GPIO14)
 *   - MFRC522 MOSI      -> NodeMCU Pin D7 (GPIO13)
 *   - MFRC522 MISO      -> NodeMCU Pin D6 (GPIO12)
 *   - MFRC522 RST       -> NodeMCU Pin D3 (GPIO0)
 *   - MFRC522 GND       -> GND
 *   - MFRC522 3.3V      -> 3.3V (DO NOT CONNECT TO 5V!)
 *
 * Optional Feedback Hardware:
 *   - Buzzer / LED      -> NodeMCU Pin D1 (GPIO5)
 *   - Status LED        -> NodeMCU Pin D2 (GPIO4)
 *
 * Dependencies (Install via Arduino Library Manager):
 *   - MFRC522 by githubmonk / miguelbalboa
 *   - ArduinoJson by Benoit Blanchon (v6.x)
 *   - ESP8266WiFi & ESP8266HTTPClient (Built into ESP8266 Board Core)
 *
 * Supabase Table SQL Setup (Run in Supabase SQL Editor if table doesn't exist):
 *   CREATE TABLE rfid_scans (
 *       id BIGINT GENERATED BY DEFAULT AS IDENTITY PRIMARY KEY,
 *       rfid_tag VARCHAR(50) NOT NULL,
 *       robot_id INT DEFAULT 1,
 *       status VARCHAR(50) DEFAULT 'scanned',
 *       scanned_at TIMESTAMP WITH TIME ZONE DEFAULT now()
 *   );
 * ----------------------------------------------------------------------------
 */

#include <ArduinoJson.h>
#include <ESP8266HTTPClient.h>
#include <ESP8266WiFi.h>
#include <MFRC522.h>
#include <SPI.h>
#include <WiFiClientSecure.h>

// ==========================================
// CONFIGURATION - Wi-Fi & Supabase Credentials
// ==========================================
const char *WIFI_SSID = "Shahriar";     // Replace with your Wi-Fi SSID
const char *WIFI_PASSWORD = "02140731"; // Replace with your Wi-Fi Password

// Supabase API details (Extracted from Project Configuration)
const char *SUPABASE_URL = "https://xmapjrywkmygxwrctiyi.supabase.co";
const char *SUPABASE_ANON_KEY =
    "eyJhbGciOiJIUzI1NiIsInR5cCI6IkpXVCJ9."
    "eyJpc3MiOiJzdXBhYmFzZSIsInJlZiI6InhtYXBqcnl3a215Z3h3cmN0aXlpIiwicm9sZSI6Im"
    "Fub24iLCJpYXQiOjE3ODM4MTIyODIsImV4cCI6MjA5OTM4ODI4Mn0."
    "boM4cXlCz4unZKALPHnQHnKrwCIg1XIh4acIDM4lP3Q";
const char *SUPABASE_TABLE = "rfid_scans"; // Table name in Supabase

// Robot Identifier
const int ROBOT_ID = 1;

// Hardware Pin Definitions for NodeMCU ESP8266
#define RST_PIN D3    // GPIO0
#define SS_PIN D8     // GPIO15
#define BUZZER_PIN D1 // GPIO5 (Optional audio/visual beep)
#define LED_PIN D2    // GPIO4 (Optional status LED)
#define ARDUINO_STOP_PIN D4 // GPIO2 (Connect to Arduino Digital Pin 2)

// Debounce settings to avoid sending duplicate scans
const unsigned long DEBOUNCE_MS = 3000;
String lastScannedUID = "";
unsigned long lastScanTime = 0;

// Initialize MFRC522 Instance
MFRC522 mfrc522(SS_PIN, RST_PIN);

// Function Declarations
void connectToWiFi();
String readTagUID();
bool sendToSupabase(const String &rfidTag);
void triggerBuzzer(int durationMs, int pulses = 1);

void setup() {
  Serial.begin(115200);
  delay(10);
  Serial.println("\n\n====================================");
  Serial.println("   AMIGO ROBOT - RFID SUPABASE HUB  ");
  Serial.println("====================================");

  pinMode(BUZZER_PIN, OUTPUT);
  pinMode(LED_PIN, OUTPUT);
  pinMode(ARDUINO_STOP_PIN, OUTPUT);

  digitalWrite(BUZZER_PIN, LOW);
  digitalWrite(LED_PIN, LOW);
  digitalWrite(ARDUINO_STOP_PIN, LOW);

  // Initialize SPI bus & MFRC522 RFID module
  SPI.begin();
  mfrc522.PCD_Init();
  delay(50);
  mfrc522.PCD_DumpVersionToSerial(); // Output MFRC522 firmware version for
                                     // debugging

  // Connect to Wi-Fi network
  connectToWiFi();
}

void loop() {
  // Ensure Wi-Fi connection remains active
  if (WiFi.status() != WL_CONNECTED) {
    connectToWiFi();
  }

  // Look for new RFID cards/tags
  if (!mfrc522.PICC_IsNewCardPresent()) {
    return;
  }

  // Select one of the cards
  if (!mfrc522.PICC_ReadCardSerial()) {
    return;
  }

  // Read card UID
  String currentUID = readTagUID();
  unsigned long now = millis();

  // Check debounce logic to prevent multiple requests for the same card scan
  if (currentUID == lastScannedUID && (now - lastScanTime) < DEBOUNCE_MS) {
    Serial.println("[RFID] Duplicate scan ignored (debouncing).");
    mfrc522.PICC_HaltA();
    mfrc522.PCD_StopCrypto1();
    return;
  }

  lastScannedUID = currentUID;
  lastScanTime = now;

  Serial.println("\n[RFID] New Tag Scanned! UID: " + currentUID);

  // Send RFID scan data to Supabase database
  digitalWrite(LED_PIN, HIGH);
  bool success = sendToSupabase(currentUID);
  digitalWrite(LED_PIN, LOW);

  if (success) {
    Serial.println("[RFID] Successfully saved scan to Supabase!");
    triggerBuzzer(100, 2); // 2 short beeps for success
    
    // Send a quick trigger pulse to the Arduino
    digitalWrite(ARDUINO_STOP_PIN, HIGH);
    delay(100); 
    digitalWrite(ARDUINO_STOP_PIN, LOW);
  } else {
    Serial.println("[RFID] Failed to send scan to Supabase.");
    triggerBuzzer(500, 1); // 1 long beep for error
  }

  // Halt PICC and stop encryption
  mfrc522.PICC_HaltA();
  mfrc522.PCD_StopCrypto1();
}

/**
 * Connects ESP8266 to the specified Wi-Fi network.
 */
void connectToWiFi() {
  Serial.print("[WiFi] Connecting to: ");
  Serial.println(WIFI_SSID);
  WiFi.mode(WIFI_STA);
  WiFi.begin(WIFI_SSID, WIFI_PASSWORD);

  int attempts = 0;
  while (WiFi.status() != WL_CONNECTED && attempts < 30) {
    delay(500);
    Serial.print(".");
    attempts++;
  }

  if (WiFi.status() == WL_CONNECTED) {
    Serial.println("\n[WiFi] Connected successfully!");
    Serial.print("[WiFi] IP Address: ");
    Serial.println(WiFi.localIP());
  } else {
    Serial.println("\n[WiFi] Connection failed! Will retry in main loop.");
  }
}

/**
 * Reads and formats the MFRC522 UID as a Hexadecimal String (e.g. "A1B2C3D4").
 */
String readTagUID() {
  String uidStr = "";
  for (byte i = 0; i < mfrc522.uid.size; i++) {
    if (mfrc522.uid.uidByte[i] < 0x10) {
      uidStr += "0";
    }
    uidStr += String(mfrc522.uid.uidByte[i], HEX);
  }
  uidStr.toUpperCase();
  return uidStr;
}

/**
 * Sends the RFID tag payload to Supabase via PostgREST API (HTTPS POST).
 */
bool sendToSupabase(const String &rfidTag) {
  if (WiFi.status() != WL_CONNECTED) {
    Serial.println("[HTTP] Cannot send data - Wi-Fi disconnected!");
    return false;
  }

  // Create a secure client for HTTPS connection to Supabase
  WiFiClientSecure client;
  client.setInsecure(); // Skip SSL certificate verification on ESP8266

  HTTPClient http;
  String targetUrl =
      String(SUPABASE_URL) + "/rest/v1/" + String(SUPABASE_TABLE);

  Serial.println("[HTTP] Connecting to Supabase URL: " + targetUrl);

  if (http.begin(client, targetUrl)) {
    // Set mandatory HTTP Headers for Supabase API
    http.addHeader("Content-Type", "application/json");
    http.addHeader("apikey", SUPABASE_ANON_KEY);
    http.addHeader("Authorization", "Bearer " + String(SUPABASE_ANON_KEY));
    http.addHeader("Prefer", "return=representation");

    // Construct JSON Payload using ArduinoJson
    StaticJsonDocument<256> doc;
    doc["rfid_tag"] = rfidTag;
    doc["robot_id"] = ROBOT_ID;
    doc["status"] = "scanned";

    String jsonPayload;
    serializeJson(doc, jsonPayload);

    Serial.println("[HTTP] Payload: " + jsonPayload);

    // Send HTTP POST request
    int httpCode = http.POST(jsonPayload);

    Serial.print("[HTTP] Response Code: ");
    Serial.println(httpCode);

    bool isSuccess = false;
    if (httpCode > 0) {
      String response = http.getString();
      Serial.println("[HTTP] Response: " + response);
      if (httpCode == HTTP_CODE_OK || httpCode == HTTP_CODE_CREATED) {
        isSuccess = true;
      }
    } else {
      Serial.printf("[HTTP] POST failed, error: %s\n",
                    http.errorToString(httpCode).c_str());
    }

    http.end();
    return isSuccess;
  } else {
    Serial.println("[HTTP] Unable to connect to Supabase server.");
    return false;
  }
}

/**
 * Optional audio/visual buzzer & LED signal helper.
 */
void triggerBuzzer(int durationMs, int pulses) {
  for (int i = 0; i < pulses; i++) {
    digitalWrite(BUZZER_PIN, HIGH);
    digitalWrite(LED_PIN, HIGH);
    delay(durationMs);
    digitalWrite(BUZZER_PIN, LOW);
    digitalWrite(LED_PIN, LOW);
    if (pulses > 1 && i < pulses - 1) {
      delay(80);
    }
  }
}
